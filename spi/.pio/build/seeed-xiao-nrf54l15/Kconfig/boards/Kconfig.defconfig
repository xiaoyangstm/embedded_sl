## spi/.pio/build/seeed-xiao-nrf54l15/Kconfig/boards/Kconfig.defconfig
```kconfig
# Load Zephyr board defconfig descriptions.
osource "C:/Users/33846/.platformio/platforms/Seeed Studio/zephyr/boards/arm/xiao_nrf54l15/Kconfig.defconfig"
```

## spi/.pio/build/seeed-xiao-nrf54l15/Kconfig/boards/Kconfig.xiao_nrf54l15
```kconfig
# Load board Kconfig descriptions.
osource "C:/Users/33846/.platformio/platforms/Seeed Studio/zephyr/boards/arm/xiao_nrf54l15/Kconfig.xiao_nrf54l15"
```

## spi_speed/.pio/build/seeed-xiao-nrf54l15/Kconfig/Kconfig.shield.defconfig
```kconfig
osource "C:\Users\33846\.platformio\packages\framework-zephyr/../../platforms/Seeed Studio/zephyr/boards/shields/*/Kconfig.defconfig"
```

## spi_speed/.pio/build/seeed-xiao-nrf54l15/Kconfig/boards/Kconfig.sysbuild
```kconfig
# Load Sysbuild board Kconfig descriptions.
osource "C:/Users/33846/.platformio/platforms/Seeed Studio/zephyr/boards/arm/xiao_nrf54l15/Kconfig.sysbuild"
```
